## firmware/main/Kconfig.projbuild
```kconfig
menu "Flukenic Configuration"
    comment "Flukenic Configuration"

    config LWIP_NETIF_HOSTNAME
        bool "Define LWIP_NETIF_HOSTNAME"
        default y

    config FLUKENIC_LOG_SDCARD
        bool "Save console log to sdcard"
        default n

    config FLUKENIC_WIFIAP_CHAN
        int "Channel of SoftAP"
        default 1

    config FLUKENIC_WIFIAP_SSID
        string "SSID of SoftAP"
        default "FlukeNIC"

    config FLUKENIC_WIFIAP_PASSWD
        string "Password of SoftAP"
        default "88408842"

endmenu
```
